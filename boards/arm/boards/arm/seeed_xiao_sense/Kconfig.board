## boards/arm/boards/arm/seeed_xiao_sense/Kconfig.board
```kconfig
# Copyright (c) 2022 Nordic Semiconductor ASA
# SPDX-License-Identifier: Apache-2.0

config BOARD_SEEED_XIAO_SENSE
	bool "Seeed XIAO Sense"
	depends on SOC_NRF52840_QIAA
```

## boards/arm/boards/arm/seeed_xiao_sense/Kconfig.defconfig
```kconfig
# Copyright (c) 2022 Nordic Semiconductor ASA
# SPDX-License-Identifier: Apache-2.0

if BOARD_SEEED_XIAO_SENSE

config BOARD
	default "seeed_xiao_sense"

config BT_CTLR
   default BT

endif
```
